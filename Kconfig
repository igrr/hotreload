## Kconfig
```kconfig
menu "Hot Reload"

    config HOTRELOAD_PARTITION
        string "Partition name for reloadable ELF"
        default "hotreload"
        help
            Name of the flash partition where reloadable ELF files are stored.
            This partition should be defined in your partitions.csv file.

    config HOTRELOAD_COMPONENTS
        string "Reloadable components (semicolon-separated)"
        default ""
        help
            Semicolon-separated list of component names to make reloadable.
            Example: "reloadable;my_module"

            This allows making components reloadable without modifying their
            CMakeLists.txt files. Components listed here will have their source
            files compiled into a reloadable shared library instead of being
            linked into the main application.

            Alternatively, add the RELOADABLE keyword to idf_component_register()
            in the component's CMakeLists.txt.

endmenu
```

## sdkconfig.defaults
```kconfig
CONFIG_PARTITION_TABLE_CUSTOM=y
CONFIG_LIBC_NEWLIB=y

# Required for agent_dev_utils coredump analysis
CONFIG_ESP_COREDUMP_ENABLE_TO_UART=y
CONFIG_ESP_SYSTEM_PANIC_PRINT_HALT=y

# Network configuration for QEMU (openeth only)
CONFIG_EXAMPLE_CONNECT_WIFI=n
CONFIG_EXAMPLE_CONNECT_ETHERNET=y
CONFIG_ETH_USE_OPENETH=y
CONFIG_ETHERNET_OPENETH_SUPPORT=y
# Disable internal EMAC and other Ethernet drivers (not supported in QEMU)
CONFIG_ETHERNET_INTERNAL_SUPPORT=n

# Disable task watchdog (unity_run_menu blocks on UART input)
CONFIG_ESP_TASK_WDT_INIT=n
```

## test_apps/hotreload_test/sdkconfig.defaults
```kconfig
# Common configuration for all builds
CONFIG_PARTITION_TABLE_CUSTOM=y
CONFIG_LIBC_NEWLIB=y

# Required for agent_dev_utils coredump analysis
CONFIG_ESP_COREDUMP_ENABLE_TO_UART=y
CONFIG_ESP_SYSTEM_PANIC_PRINT_HALT=y

# Disable task watchdog (unity_run_menu blocks on UART input)
CONFIG_ESP_TASK_WDT_INIT=n
```

## test_apps/hotreload_test/sdkconfig.defaults.esp32c3
```kconfig
# ESP32-C3 specific configuration
# This file is applied when building for ESP32-C3 target

# Use USB Serial/JTAG for console (required for boards without UART bridge)
CONFIG_ESP_CONSOLE_USB_SERIAL_JTAG=y

# Disable memory protection to allow loading executable code at runtime
# Hot reload requires executing code from dynamically allocated memory,
# which conflicts with W^X (write XOR execute) enforcement
CONFIG_ESP_SYSTEM_MEMPROT_FEATURE=n

# Required for agent_dev_utils coredump capture and crash analysis
CONFIG_ESP_COREDUMP_ENABLE_TO_UART=y
CONFIG_ESP_SYSTEM_PANIC_PRINT_HALT=y
```

## test_apps/hotreload_test/sdkconfig.defaults.esp32c3.qemu
```kconfig
# ESP32-C3 QEMU-specific configuration
# This file overrides esp32c3 settings for QEMU emulation

# Use UART console instead of USB Serial/JTAG (QEMU doesn't support reading from USB_SERIAL_JTAG)
CONFIG_ESP_CONSOLE_UART_DEFAULT=y
CONFIG_ESP_CONSOLE_USB_SERIAL_JTAG=n
```

## test_apps/hotreload_test/sdkconfig.defaults.esp32c6
```kconfig
# ESP32-C6 specific configuration
# This file is applied when building for ESP32-C6 target

# Disable memory protection to allow loading executable code at runtime
# Hot reload requires executing code from dynamically allocated memory,
# which conflicts with W^X (write XOR execute) enforcement
CONFIG_ESP_SYSTEM_MEMPROT_FEATURE=n

# Required for agent_dev_utils coredump capture and crash analysis
CONFIG_ESP_COREDUMP_ENABLE_TO_UART=y
CONFIG_ESP_SYSTEM_PANIC_PRINT_HALT=y
```

## test_apps/hotreload_test/sdkconfig.defaults.esp32p4
```kconfig
# ESP32-P4 specific configuration
# This file is applied when building for ESP32-P4 target

# Use UART console (default, not USB-Serial/JTAG)
CONFIG_ESP_CONSOLE_UART_DEFAULT=y

# Support chip revision v1.0 (requires enabling revisions <3.0)
CONFIG_ESP32P4_SELECTS_REV_LESS_V3=y
CONFIG_ESP32P4_REV_MIN_100=y

# Disable memory protection to allow loading executable code at runtime
# Hot reload requires executing code from dynamically allocated memory,
# which conflicts with W^X (write XOR execute) enforcement
CONFIG_ESP_SYSTEM_MEMPROT_FEATURE=n

# Enable PSRAM support (ESP32-P4-Function-EV-Board has PSRAM)
CONFIG_SPIRAM=y
CONFIG_SPIRAM_MODE_HEX=y
CONFIG_SPIRAM_SPEED_200M=y

# Allow allocating from PSRAM with heap_caps
CONFIG_SPIRAM_USE_CAPS_ALLOC=y

# Required for agent_dev_utils coredump capture and crash analysis
CONFIG_ESP_COREDUMP_ENABLE_TO_UART=y
CONFIG_ESP_SYSTEM_PANIC_PRINT_HALT=y

# Enable Ethernet connection for E2E tests (must be before ETHERNET_INTERNAL_SUPPORT)
CONFIG_EXAMPLE_CONNECT_ETHERNET=y

# Enable internal Ethernet MAC (ESP32-P4-Function-EV-Board)
CONFIG_ETH_USE_ESP32_EMAC=y
CONFIG_ETHERNET_INTERNAL_SUPPORT=y
CONFIG_ETHERNET_PHY_INTERFACE_DEFAULT=y
CONFIG_ETHERNET_PHY_IP101=y
```

## test_apps/hotreload_test/sdkconfig.defaults.esp32s2
```kconfig
# ESP32-S2 specific configuration for dynamic code loading from PSRAM

# Use UART for console (board with external USB-to-UART bridge on GPIO 43/44)
# CONFIG_ESP_CONSOLE_USB_SERIAL_JTAG=y

# Enable PSRAM (SPIRAM) support
CONFIG_SPIRAM=y
CONFIG_SPIRAM_MODE_AUTO=y
CONFIG_SPIRAM_SPEED_80M=y

# Allow allocation from PSRAM
CONFIG_SPIRAM_USE_MALLOC=y
CONFIG_SPIRAM_MALLOC_ALWAYSINTERNAL=4096
```

## test_apps/hotreload_test/sdkconfig.defaults.esp32s2.nopsram
```kconfig
# ESP32-S2 configuration WITHOUT PSRAM
# Uses internal RAM with memory protection disabled

# Disable PSRAM
# CONFIG_SPIRAM is not set

# Disable memory protection to allow code execution from internal RAM
CONFIG_ESP_SYSTEM_MEMPROT=n
```

## test_apps/hotreload_test/sdkconfig.defaults.esp32s3
```kconfig
# ESP32-S3 specific configuration

# Use USB Serial/JTAG for console (required for boards without UART bridge)
CONFIG_ESP_CONSOLE_USB_SERIAL_JTAG=y

# Enable PSRAM support
CONFIG_SPIRAM=y
CONFIG_SPIRAM_MODE_OCT=y
CONFIG_SPIRAM_SPEED_80M=y

# Allow allocating from PSRAM with heap_caps
CONFIG_SPIRAM_USE_CAPS_ALLOC=y

# Increase main task stack for test framework
CONFIG_ESP_MAIN_TASK_STACK_SIZE=8192
```

## test_apps/hotreload_test/sdkconfig.defaults.esp32s3.nopsram
```kconfig
# ESP32-S3 configuration WITHOUT PSRAM
# Uses internal RAM with memory protection disabled

# Use USB Serial/JTAG for console (required for boards without UART bridge)
CONFIG_ESP_CONSOLE_USB_SERIAL_JTAG=y

# Disable PSRAM
# CONFIG_SPIRAM is not set

# Disable memory protection to allow code execution from internal RAM
CONFIG_ESP_SYSTEM_MEMPROT=n
```

## test_apps/hotreload_test/sdkconfig.defaults.esp32s3.qemu
```kconfig
# ESP32-S3 QEMU-specific configuration
# This file overrides esp32s3 settings for QEMU emulation

# Use UART console instead of USB Serial/JTAG (QEMU doesn't support USB JTAG)
CONFIG_ESP_CONSOLE_UART_DEFAULT=y
CONFIG_ESP_CONSOLE_USB_SERIAL_JTAG=n

# Enable PSRAM. QEMU must be started with -m 4M flag.
CONFIG_SPIRAM=y
CONFIG_SPIRAM_MODE_QUAD=y
CONFIG_SPIRAM_SPEED_80M=y
CONFIG_SPIRAM_USE_CAPS_ALLOC=y
```

## test_apps/hotreload_test/sdkconfig.defaults.hardware
```kconfig
# Hardware-specific configuration
# This file is applied when building for real ESP32 hardware.
# Chip-specific files (sdkconfig.defaults.<chip>) are listed AFTER this file
# in CMakePresets.json, so they can override these settings.

# Disable networking by default for unit tests.
# Chips that need networking for E2E tests (e.g. ESP32-P4 with Ethernet)
# re-enable it in their chip-specific sdkconfig.defaults.<chip>.
# Users can also enable WiFi via sdkconfig.local with their credentials.
CONFIG_EXAMPLE_CONNECT_WIFI=n
CONFIG_EXAMPLE_CONNECT_ETHERNET=n

# Disable OpenETH (QEMU-only virtual NIC)
CONFIG_ETH_USE_OPENETH=n
```

## test_apps/hotreload_test/sdkconfig.defaults.qemu
```kconfig
# QEMU-specific configuration
# This file is applied when building for QEMU emulation

# Network configuration for QEMU (OpenETH virtual NIC)
CONFIG_EXAMPLE_CONNECT_WIFI=n
CONFIG_EXAMPLE_CONNECT_ETHERNET=y
CONFIG_ETH_USE_OPENETH=y
CONFIG_ETHERNET_OPENETH_SUPPORT=y

# Disable internal EMAC and other Ethernet drivers (not supported in QEMU)
CONFIG_ETHERNET_INTERNAL_SUPPORT=n

# Disable SPI Ethernet drivers (W5500, etc.) - they don't work in QEMU
CONFIG_ETHERNET_SPI_SUPPORT=n
CONFIG_ETHERNET_SPI_USE_W5500=0
CONFIG_ETHERNET_SPI_USE_DM9051=0
CONFIG_ETHERNET_SPI_USE_KSZ8851SNL=0
```
